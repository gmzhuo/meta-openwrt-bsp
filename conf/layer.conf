## conf/layer.conf
```bitbake
# We have a conf and classes directory, add to BBPATH
BBPATH .= ":${LAYERDIR}"

# We have recipes-* directories, add to BBFILES
BBFILES += "${LAYERDIR}/recipes-*/*/*.bb \
            ${LAYERDIR}/recipes-*/*/*.bbappend"

BBFILE_COLLECTIONS += "meta-openwrt-bsp"
BBFILE_PATTERN_meta-openwrt-bsp = "^${LAYERDIR}/"
BBFILE_PRIORITY_meta-openwrt-bsp = "6"

LAYERDEPENDS_meta-openwrt-bsp = "core"
LAYERSERIES_COMPAT_meta-openwrt-bsp = "honister"
```

## conf/machine/ap143.conf
```bitbake
MACHINEOVERRIDES =. "qemumips:"

require include/ath79.conf

KMACHINE = "qemumips"

PREFERRED_VERSION_linux-yocto = "5.10%"

KERNEL_FEATURE_BSP_PATH ?= "ath79"
KERNEL_FEATURE_BSP_PATCH_PATHS ?= "patches-5.10"
KERNEL_FEATURE_BSP_CONFIG = "config-ath79-5.10.cfg"

OPENWRT_KERNEL_DTS_PATH = "ath79"
MACHINE_DEFAULT_DTB = "qca9533_qca_ap143-flat.dtb"
UBOOT_LOADADDRESS = "0x80060000"
UBOOT_ENTRYPOINT = "0x80060000"

OPENWRT_SRC_URI="git://github.com/robimarko/openwrt.git;protocol=https;branch=IPQ807x-5.10-backports"
```

## conf/machine/ap1700v2.conf
```bitbake
MACHINEOVERRIDES =. "qemumips:"

require include/ath79.conf

KMACHINE = "qemumips"

PREFERRED_VERSION_linux-yocto = "5.10%"

KERNEL_FEATURE_BSP_PATH ?= "ath79"
KERNEL_FEATURE_BSP_PATCH_PATHS ?= "patches-5.10"
KERNEL_FEATURE_BSP_CONFIG = "config-ath79-5.10.cfg"

OPENWRT_KERNEL_DTS_PATH = "ath79"
MACHINE_DEFAULT_DTB = "qca9558_qca_ap1700m_16m_v2.dtb"
UBOOT_LOADADDRESS = "0x80060000"
UBOOT_ENTRYPOINT = "0x80060000"

OPENWRT_SRC_URI="git://github.com/openwrt/openwrt.git;protocol=https;branch=master"
```

## conf/machine/bananapi_bpi-r64.conf
```bitbake
MACHINEOVERRIDES =. "qemuarm64:"

require include/mt7622.conf

KMACHINE = "qemuarm64"

PREFERRED_VERSION_linux-yocto = "5.10%"

KERNEL_FEATURE_BSP_PATH ?= "mediatek"
KERNEL_FEATURE_BSP_PATCH_PATHS ?= "patches-5.10"
KERNEL_FEATURE_BSP_CONFIG = "config-mt7622-5.10.cfg"

OPENWRT_KERNEL_DTS_PATH = "mediatek"
MACHINE_DEFAULT_DTB = "mt7622-bananapi-bpi-r64.dtb"
KERNEL_DEVICETREE:append = " mediatek/mt7622-bananapi-bpi-r64-pcie1.dtbo mediatek/mt7622-bananapi-bpi-r64-sata.dtbo"
UBOOT_LOADADDRESS = "0x44000000"
UBOOT_ENTRYPOINT = "0x44000000"

UBOOT_MKIMAGE_EXTERNAL = " -E -B 0x1000 -p 0x1000 "
FIT_IMAGE_ROOTFS_TYPE = "squashfs-xz"

OPENWRT_SRC_URI="git://github.com/openwrt/openwrt.git;protocol=https;branch=master"
```

## conf/machine/hc5761.conf
```bitbake
MACHINEOVERRIDES =. "qemumips:"

require include/mt7620.conf

KMACHINE = "qemumips"

PREFERRED_VERSION_linux-yocto = "5.10%"

KERNEL_FEATURE_BSP_PATH ?= "ramips"
KERNEL_FEATURE_BSP_PATCH_PATHS ?= "patches-5.10"
KERNEL_FEATURE_BSP_CONFIG = "config-mt7620-5.10.cfg"

OPENWRT_KERNEL_DTS_PATH = "ralink"
MACHINE_DEFAULT_DTB = "mt7620a_hiwifi_hc5761.dtb"
UBOOT_LOADADDRESS = "0x80000000"
UBOOT_ENTRYPOINT = "0x80000000"

OPENWRT_SRC_URI="git://github.com/openwrt/openwrt.git;protocol=https;branch=master"
```

## conf/machine/include/ath79.conf
```bitbake
#@TYPE: Machine
#@NAME: QEMU MIPS32 machine
#@DESCRIPTION: Machine configuration for running a MIPS system on QEMU

require ${COREBASE}/meta/conf/machine/include/mips/tune-mips-24k.inc
DEFAULTTUNE = "mips32r2-24kc"

KERNEL_IMAGETYPE="uImage"

UBOOT_MACHINE ?= "malta_defconfig"

SERIAL_CONSOLES ?= "115200;ttyS0 115200;ttyS1"

QB_SYSTEM_NAME = "qemu-system-mips"

QB_CPU = "-cpu 24Kc"

KMACHINE = "qemumips"

MACHINE_EXTERNAL_PATCH = "patches/ath79/9999-machine.ph"

UBOOT_LOADADDRESS ?= "0x81000000"
UBOOT_ENTRYPOINT ?= "0x81000000"
```

## conf/machine/include/ipq807x.conf
```bitbake
MACHINEOVERRIDES =. "qemuarm64:"

require ${COREBASE}/meta/conf/machine/include/arm/armv8a/tune-cortexa53.inc
DEFAULTTUNE = "cortexa53"
KERNEL_IMAGETYPE = "Image"
SERIAL_CONSOLES ?= "115200;ttyMSM0"

KMACHINE = "qemuarm64"
SOC_TYPE = "ipq807x"
SOC_TYPE_AND_WIDTH = "ipq807x_64"

PREFERRED_VERSION_linux-yocto = "5.15%"

KERNEL_FEATURE_BSP_PATH ?= "ipq807x"
KERNEL_FEATURE_BSP_PATCH_PATHS ?= "patches-5.15"
KERNEL_FEATURE_BSP_CONFIG = "config-ipq807x-5.15.cfg"
MACHINE_EXTERNAL_PATCH = "patches/ipq807x/9999-machine.ph"

UBOOT_LOADADDRESS = "0x41000000"
UBOOT_ENTRYPOINT = "0x41000000"
```

## conf/machine/include/mt7620.conf
```bitbake
#@TYPE: Machine
#@NAME: QEMU MIPS32 machine
#@DESCRIPTION: Machine configuration for running a MIPS system on QEMU


require ${COREBASE}/meta/conf/machine/include/mips/tune-mips-24k.inc
DEFAULTTUNE = "mips32r2el-24kec"

KERNEL_IMAGETYPE="uImage"

UBOOT_MACHINE ?= "malta_defconfig"

SERIAL_CONSOLES ?= "115200;ttyS0 115200;ttyS1"

QB_SYSTEM_NAME = "qemu-system-mips"

QB_CPU = "-cpu 24Kc"

KMACHINE = "qemumips"

MACHINE_EXTERNAL_PATCH = "patches/mt7620/9999-machine.ph"

UBOOT_LOADADDRESS ?= "0x80000000"
UBOOT_ENTRYPOINT ?= "0x80000000"
```

## conf/machine/include/mt7622.conf
```bitbake
#@TYPE: Machine
#@NAME: QEMU MIPS32 machine
#@DESCRIPTION: Machine configuration for running a arm64 system on mt7622


require ${COREBASE}/meta/conf/machine/include/arm/armv8a/tune-cortexa53.inc
DEFAULTTUNE = "cortexa53"
KERNEL_IMAGETYPE = "Image"

SERIAL_CONSOLES ?= "115200;ttyS0 115200;ttyS1"

QB_SYSTEM_NAME = "qemu-system-aarch64"

QB_CPU = "-cpu 24Kc"

KMACHINE = "qemumips"

MACHINE_EXTERNAL_PATCH = "patches/mt7622/9999-machine.ph"

UBOOT_LOADADDRESS ?= "0x80000000"
UBOOT_ENTRYPOINT ?= "0x80000000"
```

## conf/machine/ipq807x.conf
```bitbake
MACHINEOVERRIDES =. "qemuarm64:"

require ${COREBASE}/meta/conf/machine/include/arm/armv8a/tune-cortexa53.inc
DEFAULTTUNE = "cortexa53"

KMACHINE = "qemuarm64"

PREFERRED_VERSION_linux-yocto = "5.15%"

KERNEL_FEATURE_BSP_PATH ?= "ipq807x"
KERNEL_FEATURE_BSP_PATCH_PATHS ?= "patches-5.15"
KERNEL_FEATURE_BSP_CONFIG = "config-ipq807x-5.15.cfg"
MACHINE_EXTERNAL_PATCH = "patches/ipq807x/9999-machine.ph"

OPENWRT_SRC_URI="git://github.com/robimarko/openwrt.git;protocol=git;branch=ipq807x-5.15-pr"
```
